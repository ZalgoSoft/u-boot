## configs/paz00_defconfig
```kconfig
CONFIG_ARM=y
CONFIG_SYS_L2CACHE_OFF=y
CONFIG_ARCH_TEGRA=y
CONFIG_TEXT_BASE=0x00110000
CONFIG_NR_DRAM_BANKS=2
CONFIG_ENV_SIZE=0x2000
CONFIG_ENV_OFFSET=0xFFFFE000
CONFIG_DEFAULT_DEVICE_TREE="tegra20-paz00"
CONFIG_SPL_STACK=0xffffc
CONFIG_SPL_TEXT_BASE=0x00108000
CONFIG_SYS_LOAD_ADDR=0x1000000
CONFIG_TEGRA20=y
CONFIG_TARGET_PAZ00=y
CONFIG_OF_SYSTEM_SETUP=y
CONFIG_SYS_PBSIZE=2087
CONFIG_SPL_FOOTPRINT_LIMIT=y
CONFIG_SPL_MAX_FOOTPRINT=0x8000
# CONFIG_SPL_SHARES_INIT_SP_ADDR is not set
CONFIG_SPL_HAVE_INIT_STACK=y
CONFIG_SPL_SYS_MALLOC=y
CONFIG_SPL_HAS_CUSTOM_MALLOC_START=y
CONFIG_SPL_CUSTOM_SYS_MALLOC_ADDR=0x90000
CONFIG_SPL_SYS_MALLOC_SIZE=0x10000
CONFIG_SYS_PROMPT="Tegra20 (Paz00) MOD # "
# CONFIG_CMD_IMI is not set
CONFIG_CMD_GPIO=y
CONFIG_CMD_MMC=y
CONFIG_CMD_USB=y
# CONFIG_CMD_SETEXPR is not set
CONFIG_CMD_PMIC=y
CONFIG_CMD_REGULATOR=y
CONFIG_CMD_EXT4_WRITE=y
# CONFIG_SPL_DOS_PARTITION is not set
# CONFIG_SPL_EFI_PARTITION is not set
CONFIG_ENV_OVERWRITE=y
CONFIG_ENV_IS_IN_MMC=y
CONFIG_ENV_RELOC_GD_ENV_ADDR=y
CONFIG_ENV_MMC_EMMC_HW_PARTITION=2
CONFIG_SYS_I2C_TEGRA=y
CONFIG_DM_PMIC=y
CONFIG_DM_REGULATOR=y
CONFIG_DM_REGULATOR_FIXED=y
CONFIG_PWM_TEGRA=y
CONFIG_SYS_NS16550=y
CONFIG_USB=y
CONFIG_USB_EHCI_HCD=y
CONFIG_USB_EHCI_TEGRA=y
CONFIG_USB_ULPI=y
CONFIG_USB_KEYBOARD=y
CONFIG_USB_HOST_ETHER=y
CONFIG_USB_ETHER_ASIX=y
CONFIG_VIDEO=y
# CONFIG_VIDEO_BPP8 is not set
CONFIG_I2C_EDID=y
CONFIG_VIDEO_TEGRA=y
CONFIG_CONSOLE_SCROLL_LINES=10

CONFIG_AES=y
CONFIG_ARCH_FIXUP_FDT_MEMORY=y
CONFIG_ARCH_SUPPORTS_LTO=y
CONFIG_ARM_ASM_UNIFIED=y
CONFIG_ARM_ERRATA_716044=y
CONFIG_ARM_ERRATA_742230=y
CONFIG_ARM_ERRATA_751472=y
CONFIG_ARP_TIMEOUT=5000
CONFIG_AUTOBOOT=y
CONFIG_AUTOBOOT_MENU_SHOW=y
CONFIG_AUTO_COMPLETE=y
CONFIG_BACKLIGHT=y
CONFIG_BACKLIGHT_PWM=y
CONFIG_BAUDRATE=115200
CONFIG_BINMAN=y
CONFIG_BINMAN_DTB=""
CONFIG_BINMAN_FDT=y
CONFIG_BLK=y
CONFIG_BLOCK_CACHE=y
CONFIG_BMP=y
CONFIG_BMP_16BPP=y
CONFIG_BMP_24BPP=y
CONFIG_BMP_32BPP=y
CONFIG_BOARD_EARLY_INIT_F=y
CONFIG_BOARD_INIT=y
CONFIG_BOARD_LATE_INIT=y
CONFIG_BOOTCOMMAND="bootflow scan"
CONFIG_BOOTDELAY=2
CONFIG_BOOTDEV_ETH=y
CONFIG_BOOTEFI_HELLO_COMPILE=y
CONFIG_BOOTEFI_TESTAPP_COMPILE=y
CONFIG_BOOTMETH_DISTRO=y
CONFIG_BOOTMETH_EFILOADER=y
CONFIG_BOOTMETH_EFI_BOOTMGR=y
CONFIG_BOOTMETH_EXTLINUX=y
CONFIG_BOOTMETH_EXTLINUX_PXE=y
CONFIG_BOOTMETH_GLOBAL=y
CONFIG_BOOTMETH_SCRIPT=y
CONFIG_BOOTM_ELF=y
CONFIG_BOOTM_LINUX=y
CONFIG_BOOTM_NETBSD=y
CONFIG_BOOTM_PLAN9=y
CONFIG_BOOTM_RTEMS=y
CONFIG_BOOTM_VXWORKS=y
CONFIG_BOOTP_BOOTPATH=y
CONFIG_BOOTP_DNS=y
CONFIG_BOOTP_GATEWAY=y
CONFIG_BOOTP_HOSTNAME=y
CONFIG_BOOTP_MAX_ROOT_PATH_LEN=64
CONFIG_BOOTP_PXE=y
CONFIG_BOOTP_PXE_DHCP_OPTION=y
CONFIG_BOOTP_SUBNETMASK=y
CONFIG_BOOTP_VCI_STRING="U-Boot.armv7"
CONFIG_BOOTSTD=y
CONFIG_BOOTSTD_BOOTCOMMAND=y
CONFIG_BOOTSTD_DEFAULTS=y
CONFIG_BOOTSTD_FULL=y
CONFIG_BOOTSTD_MENU=y
CONFIG_BOOT_DEFAULTS=y
CONFIG_BOOT_DEFAULTS_CMDS=y
CONFIG_BOOT_DEFAULTS_FEATURES=y
CONFIG_BOUNCE_BUFFER=y
CONFIG_BUILD_BIN2C=y
CONFIG_BUILD_TARGET=""
CONFIG_CC_HAS_ASM_INLINE=y
CONFIG_CC_IS_GCC=y
CONFIG_CC_OPTIMIZE_FOR_SIZE=y
CONFIG_CEDIT=y
CONFIG_CHARSET=y
CONFIG_CI_UDC=y
CONFIG_CLANG_VERSION=0
CONFIG_CLK=y
CONFIG_CLK_STUB=y
CONFIG_CMDLINE=y
CONFIG_CMDLINE_EDITING=y
CONFIG_CMD_ASKENV=y
CONFIG_CMD_BDI=y
CONFIG_CMD_BDINFO_EXTRA=y
CONFIG_CMD_BIND=y
CONFIG_CMD_BLOCK_CACHE=y
CONFIG_CMD_BMP=y
CONFIG_CMD_BOOTD=y
CONFIG_CMD_BOOTDEV=y
CONFIG_CMD_BOOTEFI=y
CONFIG_CMD_BOOTEFI_BINARY=y
CONFIG_CMD_BOOTEFI_BOOTMGR=y
CONFIG_CMD_BOOTEFI_HELLO=y
CONFIG_CMD_BOOTFLOW=y
CONFIG_CMD_BOOTFLOW_FULL=y
CONFIG_CMD_BOOTM=y
CONFIG_CMD_BOOTMENU=y
CONFIG_CMD_BOOTMETH=y
CONFIG_CMD_BOOTP=y
CONFIG_CMD_BOOTSTD=y
CONFIG_CMD_BOOTZ=y
CONFIG_CMD_CACHE=y
CONFIG_CMD_CAT=y
CONFIG_CMD_CEDIT=y
CONFIG_CMD_CLK=y
CONFIG_CMD_CLONE=y
CONFIG_CMD_CLS=y
CONFIG_CMD_CONFIG=y
CONFIG_CMD_CONITRACE=y
CONFIG_CMD_CONSOLE=y
CONFIG_CMD_CRC32=y
CONFIG_CMD_CYCLIC=y
CONFIG_CMD_DATE=y
CONFIG_CMD_DFU=y
CONFIG_CMD_DHCP=y
CONFIG_CMD_DM=y
CONFIG_CMD_EBTUPDATE=y
CONFIG_CMD_ECHO=y
CONFIG_CMD_EDITENV=y
CONFIG_CMD_EFICONFIG=y
CONFIG_CMD_EFIDEBUG=y
CONFIG_CMD_ELF=y
CONFIG_CMD_ELF_BOOTVX=y
CONFIG_CMD_ENTERRCM=y
CONFIG_CMD_ENV_CALLBACK=y
CONFIG_CMD_ENV_EXISTS=y
CONFIG_CMD_ENV_FLAGS=y
CONFIG_CMD_ERASEENV=y
CONFIG_CMD_EVENT=y
CONFIG_CMD_EXPORTENV=y
CONFIG_CMD_EXT2=y
CONFIG_CMD_EXT4=y
CONFIG_CMD_FAT=y
CONFIG_CMD_FDT=y
CONFIG_CMD_FS_GENERIC=y
CONFIG_CMD_FS_UUID=y
CONFIG_CMD_GETTIME=y
CONFIG_CMD_GO=y
CONFIG_CMD_GPT=y
CONFIG_CMD_GPT_RENAME=y
CONFIG_CMD_GREPENV=y
CONFIG_CMD_HELP=y
CONFIG_CMD_HISTORY=y
CONFIG_CMD_HISTORY_USE_CALLOC=y
CONFIG_CMD_I2C=y
CONFIG_CMD_IMI=y
CONFIG_CMD_IMPORTENV=y
CONFIG_CMD_INI=y
CONFIG_CMD_ITEST=y
CONFIG_CMD_LOADB=y
CONFIG_CMD_LOADS=y
CONFIG_CMD_LOADXY_TIMEOUT=90
CONFIG_CMD_LOG=y
CONFIG_CMD_LSBLK=y
CONFIG_CMD_MBR=y
CONFIG_CMD_MEMINFO=y
CONFIG_CMD_MEMINFO_MAP=y
CONFIG_CMD_MEMORY=y
CONFIG_CMD_MII=y
CONFIG_CMD_MX_CYCLIC=y
CONFIG_CMD_NET=y
CONFIG_CMD_NVEDIT_EFI=y
CONFIG_CMD_NVEDIT_INDIRECT=y
CONFIG_CMD_NVEDIT_INFO=y
CONFIG_CMD_NVEDIT_LOAD=y
CONFIG_CMD_NVEDIT_SELECT=y
CONFIG_CMD_PART=y
CONFIG_CMD_PAUSE=y
CONFIG_CMD_PING=y
CONFIG_CMD_PINMUX=y
CONFIG_CMD_PSTORE=y
CONFIG_CMD_PSTORE_CONSOLE_SIZE=0x1000
CONFIG_CMD_PSTORE_ECC_SIZE=0
CONFIG_CMD_PSTORE_FTRACE_SIZE=0x1000
CONFIG_CMD_PSTORE_MEM_ADDR=0x250000
CONFIG_CMD_PSTORE_MEM_SIZE=0x10000
CONFIG_CMD_PSTORE_PMSG_SIZE=0x1000
CONFIG_CMD_PSTORE_RECORD_SIZE=0x1000
CONFIG_CMD_PWM=y
CONFIG_CMD_PXE=y
CONFIG_CMD_RANDOM=y
CONFIG_CMD_READ=y
CONFIG_CMD_RTC=y
CONFIG_CMD_RUN=y
CONFIG_CMD_SAVEENV=y
CONFIG_CMD_SELECT_FONT=y
CONFIG_CMD_SETEXPR=y
CONFIG_CMD_SETEXPR_FMT=y
CONFIG_CMD_SF=y
CONFIG_CMD_SLEEP=y
CONFIG_CMD_SMBIOS=y
CONFIG_CMD_SOURCE=y
CONFIG_CMD_SPAWN_NUM_JOBS=16
CONFIG_CMD_STRINGS=y
CONFIG_CMD_SYSBOOT=y
CONFIG_CMD_TFTPBOOT=y
CONFIG_CMD_TIME=y
CONFIG_CMD_TIMER=y
CONFIG_CMD_UFETCH=y
CONFIG_CMD_UMS_ABORT_KEYED=y
CONFIG_CMD_USB_MASS_STORAGE=y
CONFIG_CMD_UUID=y
CONFIG_CMD_VIDCONSOLE=y
CONFIG_CMD_WRITE=y
CONFIG_CMD_XIMG=y
CONFIG_CMD_XXD=y
CONFIG_CONSOLE_FLUSH_SUPPORT=y
CONFIG_CONSOLE_MUX=y
CONFIG_CONSOLE_NORMAL=y
CONFIG_COUNTER_FREQUENCY=0
CONFIG_CPU_V7A=y
CONFIG_CRC16=y
CONFIG_CRC32=y
CONFIG_CRC32_VERIFY=y
CONFIG_CRC8=y
CONFIG_CREATE_ARCH_SYMLINK=y
CONFIG_CYCLIC=y
CONFIG_CYCLIC_MAX_CPU_TIME_US=5000
CONFIG_DEFAULT_FDT_FILE=""
CONFIG_DEVICE_TREE_INCLUDES=""
CONFIG_DEVRES=y
CONFIG_DFU=y
CONFIG_DFU_NAME_MAX_SIZE=32
CONFIG_DFU_OVER_USB=y
CONFIG_DHCP_PXE_CLIENTARCH=0x15
CONFIG_DISPLAY_BOARDINFO=y
CONFIG_DISPLAY_CPUINFO=y
CONFIG_DM=y
CONFIG_DM_AES=y
CONFIG_DM_DEVICE_REMOVE=y
CONFIG_DM_DEV_READ_INLINE=y
CONFIG_DM_ETH=y
CONFIG_DM_EVENT=y
CONFIG_DM_GPIO=y
CONFIG_DM_I2C=y
CONFIG_DM_KEYBOARD=y
CONFIG_DM_MMC=y
CONFIG_DM_PWM=y
CONFIG_DM_REGULATOR_COMMON=y
CONFIG_DM_REGULATOR_GPIO=y
CONFIG_DM_RESET=y
CONFIG_DM_RTC=y
CONFIG_DM_SEQ_ALIAS=y
CONFIG_DM_SERIAL=y
CONFIG_DM_SPI=y
CONFIG_DM_SPI_FLASH=y
CONFIG_DM_STDIO=y
CONFIG_DM_USB=y
CONFIG_DOS_PARTITION=y
CONFIG_DTOC=y
CONFIG_EFI=y
CONFIG_EFI_BINARY_EXEC=y
CONFIG_EFI_BOOTMGR=y
CONFIG_EFI_CAPSULE_MAX=15
CONFIG_EFI_DEBUG_SUPPORT=y
CONFIG_EFI_DEVICE_PATH_TO_TEXT=y
CONFIG_EFI_DEVICE_PATH_UTIL=y
CONFIG_EFI_DT_FIXUP=y
CONFIG_EFI_EBBR_2_1_CONFORMANCE=y
CONFIG_EFI_ECPT=y
CONFIG_EFI_GET_TIME=y
CONFIG_EFI_GRUB_ARM32_WORKAROUND=y
CONFIG_EFI_LOADER=y
CONFIG_EFI_LOADER_HII=y
CONFIG_EFI_LOAD_FILE2_INITRD=y
CONFIG_EFI_MEDIA=y
CONFIG_EFI_PARTITION=y
CONFIG_EFI_PARTITION_ENTRIES_NUMBERS=128
CONFIG_EFI_PARTITION_ENTRIES_OFF=0
CONFIG_EFI_PLATFORM_LANG_CODES="en-US"
CONFIG_EFI_RT_VOLATILE_STORE=y
CONFIG_EFI_SET_TIME=y
CONFIG_EFI_UNICODE_CAPITALIZATION=y
CONFIG_EFI_UNICODE_COLLATION_PROTOCOL2=y
CONFIG_EFI_VARIABLE_FILE_STORE=y
CONFIG_EFI_VAR_BUF_SIZE=131072
CONFIG_ENV_CALLBACK_LIST_STATIC=""
CONFIG_ENV_MAX_ENTRIES=512
CONFIG_ENV_MIN_ENTRIES=64
CONFIG_ENV_MMC_DEVICE_INDEX=0
CONFIG_ENV_SOURCE_FILE=""
CONFIG_ENV_SUPPORT=y
CONFIG_ENV_VARS_UBOOT_CONFIG=y
CONFIG_ENV_VARS_UBOOT_RUNTIME_CONFIG=y
CONFIG_ERR_PTR_OFFSET=0x0
CONFIG_ETH=y
CONFIG_EVENT=y
CONFIG_EVENT_DYNAMIC=y
CONFIG_EXPERT=y
CONFIG_EXPO=y
CONFIG_EXT4_WRITE=y
CONFIG_FAT_RENAME=y
CONFIG_FAT_WRITE=y
CONFIG_FS_EXT4=y
CONFIG_FS_FAT=y
CONFIG_FS_FAT_MAX_CLUSTSIZE=65536
CONFIG_FWU_NUM_BANKS=2
CONFIG_FWU_NUM_IMAGES_PER_BANK=2
CONFIG_GCC_VERSION=130300
CONFIG_GENERATE_SMBIOS_TABLE=y
CONFIG_GENERATE_SMBIOS_TABLE_VERBOSE=y
CONFIG_GETOPT=y
CONFIG_GPIO=y
CONFIG_GPIO_EXTRA_HEADER=y
CONFIG_GZIP=y
CONFIG_HASH=y
CONFIG_HAS_THUMB2=y
CONFIG_HAS_VBAR=y
CONFIG_HAVE_INITJMP=y
CONFIG_HAVE_PRIVATE_LIBGCC=y
CONFIG_HAVE_SETJMP=y
CONFIG_HAVE_TEXT_BASE=y
CONFIG_HIDE_LOGO_VERSION=y
CONFIG_HOST1X_TEGRA=y
CONFIG_HUSH_OLD_PARSER=y
CONFIG_HUSH_PARSER=y
CONFIG_I2C=y
CONFIG_IDENT_STRING=""
CONFIG_INPUT=y
CONFIG_ISO_PARTITION=y
CONFIG_LAST_STAGE_INIT=y
CONFIG_LEGACY_CRYPTO=y
CONFIG_LEGACY_HASHING=y
CONFIG_LEGACY_HASHING_AND_CRYPTO=y
CONFIG_LEGACY_IMAGE_FORMAT=y
CONFIG_LIB_DATE=y
CONFIG_LIB_ELF=y
CONFIG_LIB_RAND=y
CONFIG_LIB_UUID=y
CONFIG_LINKER_LIST_ALIGN=4
CONFIG_LMB=y
CONFIG_LOCALVERSION=""
CONFIG_LOCALVERSION_AUTO=y
CONFIG_LOG=y
CONFIG_LOGF_FUNC_PAD=20
CONFIG_LOGLEVEL=4
CONFIG_LOG_CONSOLE=y
CONFIG_LOG_DEFAULT_LEVEL=6
CONFIG_LOG_MAX_LEVEL=6
CONFIG_MENU=y
CONFIG_MISC=y
CONFIG_MKIMAGE_DTC_PATH="dtc"
CONFIG_MMC=y
CONFIG_MMC_HW_PARTITIONING=y
CONFIG_MMC_QUIRKS=y
CONFIG_MMC_SDHCI_TEGRA=y
CONFIG_MMC_VERBOSE=y
CONFIG_MMC_WRITE=y
CONFIG_MTD=y
CONFIG_MTDIDS_DEFAULT=""
CONFIG_MTDPARTS_DEFAULT=""
CONFIG_MULTI_DTB_FIT_UNCOMPRESS_SZ=0x8000
CONFIG_NET=y
CONFIG_NETDEVICES=y
CONFIG_NET_RETRY_COUNT=5
CONFIG_NET_TFTP_VARS=y
CONFIG_OFNODE_MULTI_TREE=y
CONFIG_OFNODE_MULTI_TREE_MAX=4
CONFIG_OF_CONTROL=y
CONFIG_OF_LIBFDT=y
CONFIG_OF_LIBFDT_ASSUME_MASK=0x0
CONFIG_OF_LIST="tegra20-paz00"
CONFIG_OF_OVERLAY_LIST=""
CONFIG_OF_REAL=y
CONFIG_OF_SEPARATE=y
CONFIG_OF_TAG_MIGRATE=y
CONFIG_OF_TRANSLATE=y
CONFIG_PANEL=y
CONFIG_PARTITIONS=y
CONFIG_PARTITION_UUIDS=y
CONFIG_PHY_RESET_DELAY=0
CONFIG_PINCONF=y
CONFIG_PINCONF_RECURSIVE=y
CONFIG_PINCTRL=y
CONFIG_PINCTRL_FULL=y
CONFIG_PINCTRL_GENERIC=y
CONFIG_PINCTRL_TEGRA=y
CONFIG_PINMUX=y
CONFIG_PLATFORM_ELFENTRY="_start"
CONFIG_PMIC_CHILDREN=y
CONFIG_POWER=y
CONFIG_PRE_CONSOLE_BUFFER=y
CONFIG_PRE_CON_BUF_ADDR=0x90000
CONFIG_PRE_CON_BUF_SZ=4096
CONFIG_PRINTF=y
CONFIG_PXE_UTILS=y
CONFIG_PYLIBFDT=y
CONFIG_REGEX=y
CONFIG_REGULATOR_PWM=y
CONFIG_REMOTEPROC_MAX_FW_SIZE=0x10000
CONFIG_REQUIRE_SERIAL_CONSOLE=y
CONFIG_RTC_EMULATION=y
CONFIG_RTC_ENABLE_32KHZ_OUTPUT=y
CONFIG_RTC_PL031=y
CONFIG_SAVEENV=y
CONFIG_SDP_LOADADDR=0x0
CONFIG_SERIAL=y
CONFIG_SERIAL_PRESENT=y
CONFIG_SERIAL_RX_BUFFER=y
CONFIG_SERIAL_RX_BUFFER_SIZE=256
CONFIG_SERVERIP_FROM_PROXYDHCP_DELAY_MS=100
CONFIG_SF_DEFAULT_BUS=0
CONFIG_SF_DEFAULT_CS=0
CONFIG_SF_DEFAULT_MODE=0x0
CONFIG_SF_DEFAULT_SPEED=1000000
CONFIG_SHA1=y
CONFIG_SHA1_LEGACY=y
CONFIG_SIMPLE_BUS=y
CONFIG_SIMPLE_PANEL=y
CONFIG_SMBIOS=y
CONFIG_SPI=y
CONFIG_SPI_FLASH=y
CONFIG_SPI_FLASH_LOCK=y
CONFIG_SPI_FLASH_SMART_HWCAPS=y
CONFIG_SPI_FLASH_UNLOCK_ALL=y
CONFIG_SPI_FLASH_USE_4K_SECTORS=y
CONFIG_SPI_MEM=y
CONFIG_SPL=y
CONFIG_SPLASH_SCREEN=y
CONFIG_SPLASH_SCREEN_ALIGN=y
CONFIG_SPLASH_SOURCE=y
CONFIG_SPL_BANNER_PRINT=y
CONFIG_SPL_BINMAN_SYMBOLS=y
CONFIG_SPL_BINMAN_UBOOT_SYMBOLS=y
CONFIG_SPL_BLK=y
CONFIG_SPL_BOARD_INIT=y
CONFIG_SPL_DM=y
CONFIG_SPL_DM_GPIO=y
CONFIG_SPL_DM_I2C=y
CONFIG_SPL_DM_INLINE_OFNODE=y
CONFIG_SPL_DM_MMC=y
CONFIG_SPL_DM_PMIC=y
CONFIG_SPL_DM_SERIAL=y
CONFIG_SPL_DM_USB=y
CONFIG_SPL_FRAMEWORK=y
CONFIG_SPL_GPIO=y
CONFIG_SPL_IMAGE="spl/u-boot-spl.bin"
CONFIG_SPL_LDSCRIPT="arch/$(ARCH)/cpu/u-boot-spl.lds"
CONFIG_SPL_LEGACY_CRYPTO=y
CONFIG_SPL_LEGACY_HASHING=y
CONFIG_SPL_LEGACY_HASHING_AND_CRYPTO=y
CONFIG_SPL_LEGACY_IMAGE_FORMAT=y
CONFIG_SPL_LIBCOMMON_SUPPORT=y
CONFIG_SPL_LIBGENERIC_SUPPORT=y
CONFIG_SPL_LOGLEVEL=4
CONFIG_SPL_MAX_SIZE=0x0
CONFIG_SPL_MISC=y
CONFIG_SPL_PAD_TO=0x0
CONFIG_SPL_PAYLOAD="u-boot.bin"
CONFIG_SPL_PINCTRL=y
CONFIG_SPL_PINCTRL_TEGRA=y
CONFIG_SPL_PMIC_CHILDREN=y
CONFIG_SPL_PRINTF=y
CONFIG_SPL_RAM_DEVICE=y
CONFIG_SPL_RAM_SUPPORT=y
CONFIG_SPL_RAW_IMAGE_SUPPORT=y
CONFIG_SPL_SERIAL=y
CONFIG_SPL_SERIAL_PRESENT=y
CONFIG_SPL_SHA1=y
CONFIG_SPL_SHA1_LEGACY=y
CONFIG_SPL_SIZE_LIMIT=0x0
CONFIG_SPL_SKIP_LOWLEVEL_INIT_ONLY=y
CONFIG_SPL_SPRINTF=y
CONFIG_SPL_STRTO=y
CONFIG_SPL_SYSRESET=y
CONFIG_SPL_SYS_MALLOC_CLEAR_ON_INIT=y
CONFIG_SPL_SYS_MALLOC_F=y
CONFIG_SPL_SYS_MALLOC_F_LEN=0x1800
CONFIG_SPL_SYS_STACK_F_CHECK_BYTE=0xaa
CONFIG_SPL_TARGET=""
CONFIG_SPL_TIMER=y
CONFIG_SPL_USE_ARCH_MEMCPY=y
CONFIG_SPL_USE_ARCH_MEMSET=y
CONFIG_SPL_USE_TINY_PRINTF=y
CONFIG_SPRINTF=y
CONFIG_STACK_SIZE=0x1000000
CONFIG_STRTO=y
CONFIG_SUPPORT_ACPI=y
CONFIG_SUPPORT_LITTLE_ENDIAN=y
CONFIG_SUPPORT_OF_CONTROL=y
CONFIG_SUPPORT_RAW_INITRD=y
CONFIG_SUPPORT_SPL=y
CONFIG_SYSINFO=y
CONFIG_SYSINFO_EXTRA=y
CONFIG_SYSINFO_GAZERBEAM=y
CONFIG_SYSINFO_GPIO=y
CONFIG_SYSINFO_SANDBOX=y
CONFIG_SYSINFO_SMBIOS=y
CONFIG_SYSRESET=y
CONFIG_SYSRESET_CMD_RESET=y
CONFIG_SYSRESET_TEGRA=y
CONFIG_SYS_ARCH="arm"
CONFIG_SYS_ARM_ARCH=7
CONFIG_SYS_ARM_CACHE_CP15=y
CONFIG_SYS_ARM_CACHE_WRITEBACK=y
CONFIG_SYS_ARM_MMU=y
CONFIG_SYS_BOARD="paz00"
CONFIG_SYS_BOOTM_LEN=0x800000
CONFIG_SYS_BOOT_RAMDISK_HIGH=y
CONFIG_SYS_CACHELINE_SIZE=64
CONFIG_SYS_CACHE_SHIFT_6=y
CONFIG_SYS_CBSIZE=2048
CONFIG_SYS_CLK_FREQ=0
CONFIG_SYS_CONFIG_NAME="tegra"
CONFIG_SYS_CONSOLE_IS_IN_ENV=y
CONFIG_SYS_CPU="armv7"
CONFIG_SYS_DEVICE_NULLDEV=y
CONFIG_SYS_DFU_DATA_BUF_SIZE=0x800000
CONFIG_SYS_DFU_MAX_FILE_SIZE=0x800000
CONFIG_SYS_DTC_PAD_BYTES=0
CONFIG_SYS_EEPROM_PAGE_WRITE_DELAY_MS=0
CONFIG_SYS_FDT_PAD=0x3000
CONFIG_SYS_HZ=1000
CONFIG_SYS_LITTLE_ENDIAN=y
CONFIG_SYS_LONGHELP=y
CONFIG_SYS_MALLOC_CLEAR_ON_INIT=y
CONFIG_SYS_MALLOC_F=y
CONFIG_SYS_MALLOC_F_LEN=0x1800
CONFIG_SYS_MALLOC_LEN=0x400000
CONFIG_SYS_MAXARGS=64
CONFIG_SYS_MEM_TOP_HIDE=0x0
CONFIG_SYS_MMC_MAX_BLK_COUNT=65535
CONFIG_SYS_MONITOR_LEN=0
CONFIG_SYS_PROMPT_HUSH_PS2="> "
CONFIG_SYS_RX_ETH_BUFFER=4
CONFIG_SYS_SOC="tegra20"
CONFIG_SYS_STDIO_DEREGISTER=y
CONFIG_SYS_UBOOT_START=0x00110000
CONFIG_SYS_USB_EVENT_POLL=y
CONFIG_SYS_VENDOR="compal"
CONFIG_SYS_WHITE_ON_BLACK=y
CONFIG_SYS_XIMG_LEN=0x800000
CONFIG_SYS_XTRACE=y
CONFIG_TEGRA_AES=y
CONFIG_TEGRA_ARMV7_COMMON=y
CONFIG_TEGRA_BACKLIGHT_PWM=y
CONFIG_TEGRA_BOARD_STRING="Compal Paz00"
CONFIG_TEGRA_CAR=y
CONFIG_TEGRA_CAR_CLOCK=y
CONFIG_TEGRA_CAR_RESET=y
CONFIG_TEGRA_CLKRST=y
CONFIG_TEGRA_COMMON=y
CONFIG_TEGRA_CRYPTO=y
CONFIG_TEGRA_DISCONNECT_UDC_ON_BOOT=y
CONFIG_TEGRA_ENABLE_UARTA=y
CONFIG_TEGRA_GPIO=y
CONFIG_TEGRA_GP_PADCTRL=y
CONFIG_TEGRA_I2C=y
CONFIG_TEGRA_MC=y
CONFIG_TEGRA_NO_BPMP=y
CONFIG_TEGRA_NVEC=y
CONFIG_TEGRA_NVEC_KEYBOARD=y
CONFIG_TEGRA_PMC=y
CONFIG_TEGRA_TIMER=y
CONFIG_TFTP_BLOCKSIZE=1468
CONFIG_TFTP_WINDOWSIZE=1
CONFIG_TIMER=y
CONFIG_TIMER_EARLY=y
CONFIG_TIMESTAMP=y
CONFIG_TOOLS_CRC16=y
CONFIG_TOOLS_CRC32=y
CONFIG_TOOLS_FIT=y
CONFIG_TOOLS_FIT_FULL_CHECK=y
CONFIG_TOOLS_FIT_PRINT=y
CONFIG_TOOLS_FIT_RSASSA_PSS=y
CONFIG_TOOLS_FIT_SIGNATURE=y
CONFIG_TOOLS_FIT_SIGNATURE_MAX_SIZE=0x10000000
CONFIG_TOOLS_FIT_VERBOSE=y
CONFIG_TOOLS_IMAGE_PRE_LOAD=y
CONFIG_TOOLS_KWBIMAGE=y
CONFIG_TOOLS_LIBCRYPTO=y
CONFIG_TOOLS_MD5=y
CONFIG_TOOLS_MKEFICAPSULE=y
CONFIG_TOOLS_OF_LIBFDT=y
CONFIG_TOOLS_SHA1=y
CONFIG_TOOLS_SHA256=y
CONFIG_TOOLS_SHA384=y
CONFIG_TOOLS_SHA512=y
CONFIG_TPS6586X_POWER=y
CONFIG_USB_EHCI_IS_TDI=y
CONFIG_USB_EHCI_TXFIFO_THRESH=0x10
CONFIG_USB_FUNCTION_MASS_STORAGE=y
CONFIG_USB_GADGET=y
CONFIG_USB_GADGET_DOWNLOAD=y
CONFIG_USB_GADGET_DUALSPEED=y
CONFIG_USB_GADGET_MANUFACTURER="NVIDIA"
CONFIG_USB_GADGET_PRODUCT_NUM=0x701a
CONFIG_USB_GADGET_VBUS_DRAW=2
CONFIG_USB_GADGET_VENDOR_NUM=0x0955
CONFIG_USB_HOST=y
CONFIG_USB_HUB_DEBOUNCE_TIMEOUT=1000
CONFIG_USB_KEYBOARD_FN_KEYS=y
CONFIG_USB_ONBOARD_HUB=y
CONFIG_USB_STORAGE=y
CONFIG_USB_ULPI_VIEWPORT=y
CONFIG_USE_ARCH_MEMCPY=y
CONFIG_USE_ARCH_MEMSET=y
CONFIG_USE_BOOTCOMMAND=y
CONFIG_USE_PRIVATE_LIBGCC=y
CONFIG_VERSION_VARIABLE=y
CONFIG_VIDEO_ANSI=y
CONFIG_VIDEO_BMP_RLE8=y
CONFIG_VIDEO_BPP16=y
CONFIG_VIDEO_BPP32=y
CONFIG_VIDEO_FONT_16X32=y
CONFIG_VIDEO_FONT_4X6=y
CONFIG_VIDEO_FONT_8X16=y
CONFIG_VIDEO_FONT_SUN12X22=y
CONFIG_VIDEO_LOGO=y
CONFIG_VIDEO_LOGO_MAX_SIZE=0x100000
CONFIG_VIDEO_PCI_DEFAULT_FB_SIZE=0x0
CONFIG_VIDEO_SYNC_CYCLIC_MS=10
CONFIG_VIDEO_SYNC_MS=100
CONFIG_WATCHDOG_TIMEOUT_MSECS=60000
```
